## base_external/Config.in
```kconfig
source "$BR2_EXTERNAL_project_base_PATH/package/client/Config.in"
source "$BR2_EXTERNAL_project_base_PATH/package/bme/Config.in"
```

## base_external/package/bme/Config.in
```kconfig
config BR2_PACKAGE_BME
	bool "bme"
	help
	  Includes the writer executable, finder.sh and tester.sh in the kernel image.
	  Used to understand buildroot external trees and package builds.
```
